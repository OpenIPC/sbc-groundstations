/dts-v1/;

/ {

	metadata {
		title = "Set OTG to host mode and switchable";
		compatible = "radxa,rock-3a", "radxa,rock-3b", "radxa,rock-3c", "radxa,zero3", "radxa,e25";
		category = "misc";
		exclusive = "usbdrd_dwc3-dr_mode";
		description = "Set OTG to host mode and switchable";
	};

	fragment@0 {
		target = <0xffffffff>;

		__overlay__ {
			status = "okay";
			dr_mode = "otg";
			usb-role-switch;
			role-switch-default-mode = "host";
		};
	};

	__fixups__ {
		usbdrd_dwc3 = "/fragment@0:target:0";
	};
};
