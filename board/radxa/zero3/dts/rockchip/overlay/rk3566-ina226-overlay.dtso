/dts-v1/;
// Thanks seriyps. https://seriyps.com/blog/2025/09/25/pair-ina226-and-raspberry-pi-ina2xx-kernel-driver/
/ {
	metadata {
		title = "Add INA226 sensor";
		compatible = "radxa,rock-3a", "radxa,rock-3b", "radxa,rock-3c", "radxa,zero3", "radxa,e25";
		category = "misc";
		description = "Add INA226 sensor";
	};

	fragment@0 {
		// i2c0 = "/i2c@fdd40000"
		// i2c1 = "/i2c@fe5a0000"
		// i2c2 = "/i2c@fe5b0000"
		// i2c3 = "/i2c@fe5c0000"
		// i2c4 = "/i2c@fe5d0000"
		// i2c5 = "/i2c@fe5e0000"
		target-path = "/i2c@fe5c0000"; // Target the I2C bus that corresponds to i2c3
		__overlay__ {
			#address-cells = <1>;
			#size-cells = <0>;
			ina226@40 {
				compatible = "ti,ina226";
				reg = <0x40>; // I2C address of the INA226 from i2cdetect
				shunt-resistor = <100000>; // Shunt resistor value in micro-ohms (0.1 ohm)
			};
		};
	};
};
