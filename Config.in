## Config.in
```kconfig
source "$BR2_EXTERNAL_OPENIPC_SBC_GS_PATH/package/rkdeveloptool/Config.in.host"
source "$BR2_EXTERNAL_OPENIPC_SBC_GS_PATH/package/aic8800/Config.in"
source "$BR2_EXTERNAL_OPENIPC_SBC_GS_PATH/package/rtl88x2cu/Config.in"
source "$BR2_EXTERNAL_OPENIPC_SBC_GS_PATH/package/rtl88x2eu/Config.in"
source "$BR2_EXTERNAL_OPENIPC_SBC_GS_PATH/package/rtl8812au/Config.in"
source "$BR2_EXTERNAL_OPENIPC_SBC_GS_PATH/package/wifibroadcast-ng/Config.in"
source "$BR2_EXTERNAL_OPENIPC_SBC_GS_PATH/package/wfb-server/Config.in"
source "$BR2_EXTERNAL_OPENIPC_SBC_GS_PATH/package/rockchip-mpp/Config.in"
source "$BR2_EXTERNAL_OPENIPC_SBC_GS_PATH/package/pixelpilot/Config.in"
source "$BR2_EXTERNAL_OPENIPC_SBC_GS_PATH/package/adaptive-link/Config.in"
source "$BR2_EXTERNAL_OPENIPC_SBC_GS_PATH/package/yaml-cli/Config.in"
source "$BR2_EXTERNAL_OPENIPC_SBC_GS_PATH/package/msposd/Config.in"
source "$BR2_EXTERNAL_OPENIPC_SBC_GS_PATH/package/yq/Config.in"
source "$BR2_EXTERNAL_OPENIPC_SBC_GS_PATH/package/drm_info/Config.in"
source "$BR2_EXTERNAL_OPENIPC_SBC_GS_PATH/package/dvrui/Config.in"

choice
    prompt "GPIO configuration method"
    help
      Select how to configure the gadget mode GPIO detection.

config BR2_BOARD_GPIO_CONFIG_CHIP_LINE
    bool "Use GPIO chip and line"
    help
      Specify GPIO using chip name and line number.

config BR2_BOARD_GPIO_CONFIG_PIN_NAME
    bool "Use GPIO pin name"
    help
      Specify GPIO using pin name.

endchoice

config BR2_FACTORY_RESET_GPIO_CHIP
    string "Factory reset GPIO chip"
    default ""
    depends on BR2_BOARD_GPIO_CONFIG_CHIP_LINE
    help
      When detected high during boot (initrd phase) issue a factory reset.

config BR2_FACTORY_RESET_GPIO_LINE
    string "Factory reset GPIO line"
    default ""
    depends on BR2_BOARD_GPIO_CONFIG_CHIP_LINE
    help
      When detected high during boot (initrd phase) issue a factory reset.

config BR2_FACTORY_RESET_GPIO_PIN_NAME
    string "Factory reset GPIO pin name"
    default ""
    depends on BR2_BOARD_GPIO_CONFIG_PIN_NAME
    help
      When detected high during boot (initrd phase) issue a factory reset.

config BR2_GADGET_MODE_GPIO_CHIP
    string "Gadget mode GPIO chip"
    default ""
    depends on BR2_BOARD_GPIO_CONFIG_CHIP_LINE
    help
      Starts gadget mode when detected high during boot (initrd phase).

config BR2_GADGET_MODE_GPIO_LINE
    string "Gadget mode GPIO line"
    default ""
    depends on BR2_BOARD_GPIO_CONFIG_CHIP_LINE
    help
      Starts gadget mode when detected high during boot (initrd phase).

config BR2_GADGET_MODE_GPIO_PIN_NAME
    string "Gadget mode GPIO pin name"
    default ""
    depends on BR2_BOARD_GPIO_CONFIG_PIN_NAME
    help
      Starts gadget mode when detected high during boot (initrd phase).

config BR2_BOARD_HOST
	string "Host/IP of your vrx in your local network"
	default 192.168.1.199
	help
	  Used during ssh-flash target to flash the image.
```

## configs/runcam_wifilink_defconfig
```kconfig
BR2_aarch64=y
BR2_cortex_a55=y
BR2_TOOLCHAIN_EXTERNAL=y
BR2_PACKAGE_OVERRIDE_FILE="${BR2_EXTERNAL_OPENIPC_SBC_GS_PATH}/board/radxa/zero3/local.mk"
BR2_TARGET_GENERIC_HOSTNAME="openipcgs"
BR2_TARGET_GENERIC_ISSUE="Welcome to OpenIPC GS"
BR2_ROOTFS_DEVICE_CREATION_DYNAMIC_EUDEV=y
BR2_TARGET_GENERIC_ROOT_PASSWD="12345"
# BR2_TARGET_GENERIC_REMOUNT_ROOTFS_RW is not set
BR2_ENABLE_LOCALE_WHITELIST="C en_US en_US.UTF-8"
BR2_GENERATE_LOCALE="C.UTF-8 en_US.UTF-8"
BR2_ROOTFS_OVERLAY="${BR2_EXTERNAL_OPENIPC_SBC_GS_PATH}/board/common/overlay ${BR2_EXTERNAL_OPENIPC_SBC_GS_PATH}/board/runcam/wifilink/overlay ${BR2_EXTERNAL_OPENIPC_SBC_GS_PATH}/board/local/overlay"
BR2_ROOTFS_PRE_BUILD_SCRIPT="${BR2_EXTERNAL_OPENIPC_SBC_GS_PATH}/board/radxa/zero3/pre-build.sh"
BR2_ROOTFS_POST_BUILD_SCRIPT="${BR2_EXTERNAL_OPENIPC_SBC_GS_PATH}/board/common/post-build-script.sh"
BR2_ROOTFS_POST_IMAGE_SCRIPT="support/scripts/genimage.sh"
BR2_ROOTFS_POST_SCRIPT_ARGS="-c ${BR2_EXTERNAL}/board/common/genimage.cfg"
BR2_LINUX_KERNEL=y
BR2_LINUX_KERNEL_CUSTOM_VERSION=y
BR2_LINUX_KERNEL_CUSTOM_VERSION_VALUE="6.1.84"
BR2_LINUX_KERNEL_USE_CUSTOM_CONFIG=y
BR2_LINUX_KERNEL_CUSTOM_CONFIG_FILE="${BR2_EXTERNAL_OPENIPC_SBC_GS_PATH}/board/radxa/zero3/linux.config"
BR2_LINUX_KERNEL_DTS_SUPPORT=y
BR2_LINUX_KERNEL_INTREE_DTS_NAME="rockchip/rk3566-radxa-zero-3e rockchip/rk3566-radxa-zero-3w-aic8800ds2 rockchip/rk3566-radxa-zero-3w-ap6212"
BR2_LINUX_KERNEL_CUSTOM_DTS_DIR="${BR2_EXTERNAL_OPENIPC_SBC_GS_PATH}/board/radxa/zero3/dts"
BR2_LINUX_KERNEL_DTB_KEEP_DIRNAME=y
BR2_LINUX_KERNEL_DTB_OVERLAY_SUPPORT=y
BR2_LINUX_KERNEL_INSTALL_TARGET=y
BR2_PACKAGE_BUSYBOX_CONFIG="${BR2_EXTERNAL}/package/busybox/busybox.config"
BR2_PACKAGE_BUSYBOX_SHOW_OTHERS=y
BR2_PACKAGE_GSTREAMER1=y
BR2_PACKAGE_GST1_PLUGINS_BASE_PLUGIN_APP=y
BR2_PACKAGE_GST1_PLUGINS_GOOD=y
BR2_PACKAGE_GST1_PLUGINS_GOOD_PLUGIN_RTP=y
BR2_PACKAGE_GST1_PLUGINS_GOOD_PLUGIN_UDP=y
BR2_PACKAGE_GST1_PLUGINS_BAD=y
BR2_PACKAGE_GST1_PLUGINS_BAD_PLUGIN_VIDEOPARSERS=y
BR2_PACKAGE_GST1_PLUGINS_UGLY=y
BR2_PACKAGE_XZ=y
BR2_PACKAGE_GIT=y
BR2_PACKAGE_JQ=y
BR2_PACKAGE_AUTOFS=y
BR2_PACKAGE_DOSFSTOOLS=y
BR2_PACKAGE_DOSFSTOOLS_FATLABEL=y
BR2_PACKAGE_DOSFSTOOLS_FSCK_FAT=y
BR2_PACKAGE_DOSFSTOOLS_MKFS_FAT=y
BR2_PACKAGE_E2FSPROGS_RESIZE2FS=y
BR2_PACKAGE_FBV=y
BR2_PACKAGE_LINUX_FIRMWARE=y
BR2_PACKAGE_LINUX_FIRMWARE_RTL_815X=y
BR2_PACKAGE_PARTED=y
BR2_PACKAGE_ROCKCHIP_RKBIN=y
BR2_PACKAGE_ROCKCHIP_RKBIN_TPL_FILENAME="bin/rk35/rk3566_ddr_1056MHz_v1.23.bin"
BR2_PACKAGE_ROCKCHIP_RKBIN_BL31_FILENAME="bin/rk35/rk3568_bl31_v1.45.elf"
BR2_PACKAGE_UBOOT_TOOLS=y
BR2_PACKAGE_PYTHON3=y
BR2_PACKAGE_PYTHON3_BZIP2=y
BR2_PACKAGE_PYTHON3_CURSES=y
BR2_PACKAGE_PYTHON_BABEL=y
BR2_PACKAGE_PYTHON_FLASK=y
BR2_PACKAGE_PYTHON_MSGPACK=y
BR2_PACKAGE_PYTHON_PYROUTE2=y
BR2_PACKAGE_PYTHON_PYYAML=y
BR2_PACKAGE_PYTHON_SERIAL=y
BR2_PACKAGE_PYTHON_TWISTED=y
BR2_PACKAGE_CA_CERTIFICATES=y
BR2_PACKAGE_CAIRO_PNG=y
BR2_PACKAGE_CAIROMM=y
BR2_PACKAGE_LIBDRM=y
BR2_PACKAGE_LIBDRM_INSTALL_TESTS=y
BR2_PACKAGE_LIBGPIOD=y
BR2_PACKAGE_LIBGPIOD_TOOLS=y
BR2_PACKAGE_CJSON=y
BR2_PACKAGE_JSON_FOR_MODERN_CPP=y
BR2_PACKAGE_YAML_CPP=y
BR2_PACKAGE_SPDLOG=y
BR2_PACKAGE_LIBCURL=y
BR2_PACKAGE_LIBCURL_CURL=y
BR2_PACKAGE_LIBCAP=y
BR2_PACKAGE_MSGPACK=y
BR2_PACKAGE_NCURSES_WCHAR=y
BR2_PACKAGE_READLINE=y
BR2_PACKAGE_DROPBEAR=y
BR2_PACKAGE_IPROUTE2=y
BR2_PACKAGE_IW=y
BR2_PACKAGE_NETCAT=y
BR2_PACKAGE_NTP=y
BR2_PACKAGE_OPENSSH=y
BR2_PACKAGE_SAMBA4=y
BR2_PACKAGE_SOCAT=y
BR2_PACKAGE_SSHPASS=y
BR2_PACKAGE_WPA_SUPPLICANT=y
BR2_PACKAGE_WPA_SUPPLICANT_AP_SUPPORT=y
BR2_PACKAGE_WPA_SUPPLICANT_OVERRIDES=y
BR2_PACKAGE_FILE=y
BR2_PACKAGE_COREUTILS=y
BR2_PACKAGE_HTOP=y
BR2_PACKAGE_KMOD_TOOLS=y
BR2_PACKAGE_UTIL_LINUX_AGETTY=y
BR2_TARGET_ROOTFS_SQUASHFS=y
# BR2_TARGET_ROOTFS_TAR is not set
BR2_TARGET_UBOOT=y
BR2_TARGET_UBOOT_USE_CUSTOM_CONFIG=y
BR2_TARGET_UBOOT_CUSTOM_CONFIG_FILE="${BR2_EXTERNAL_OPENIPC_SBC_GS_PATH}/board/radxa/zero3/uboot_bsp_defconfig"
BR2_TARGET_UBOOT_NEEDS_DTC=y
BR2_TARGET_UBOOT_NEEDS_PYLIBFDT=y
BR2_TARGET_UBOOT_NEEDS_PYELFTOOLS=y
BR2_TARGET_UBOOT_NEEDS_GNUTLS=y
BR2_TARGET_UBOOT_NEEDS_ROCKCHIP_RKBIN=y
BR2_PACKAGE_HOST_E2FSPROGS=y
BR2_PACKAGE_HOST_GENIMAGE=y
BR2_PACKAGE_HOST_KMOD_XZ=y
BR2_PACKAGE_HOST_SWIG=y
BR2_PACKAGE_HOST_RKDEVELOPTOOL=y
BR2_PACKAGE_AIC8800=y
BR2_PACKAGE_RTL88X2CU=y
BR2_PACKAGE_RTL88X2EU=y
BR2_PACKAGE_RTL8812AU=y
BR2_PACKAGE_WIFIBROADCAST_NG=y
BR2_PACKAGE_WFB_SERVER=y
BR2_PACKAGE_PIXELPILOT=y
BR2_PACKAGE_ADAPTIVE_LINK=y
BR2_PACKAGE_YAML_CLI=y
BR2_PACKAGE_MSPOSD=y
BR2_PACKAGE_YQ=y
BR2_PACKAGE_DRM_INFO=y
BR2_PACKAGE_DVRUI=y
BR2_BOARD_GPIO_CONFIG_PIN_NAME=y
BR2_FACTORY_RESET_GPIO_PIN_NAME="PIN_38"
BR2_GADGET_MODE_GPIO_PIN_NAME="PIN_13"
BR2_PACKAGE_LRZSZ=y
BR2_PACKAGE_WIRELESS_REGDB=y
```

## package/adaptive-link/Config.in
```kconfig
config BR2_PACKAGE_ADAPTIVE_LINK
	bool "adaptive-link"
	help
	  Greg's Adaptive-Link - Files for OpenIPC camera and Radxa Zero 3w/e ground station

	  https://github.com/OpenIPC/adaptive-link
```

## package/aic8800/Config.in
```kconfig
config BR2_PACKAGE_AIC8800
	bool "aic8800"
	help
	  Build kernel using Radxa BSP tooling
```

## package/drm_info/Config.in
```kconfig
config BR2_PACKAGE_DRM_INFO
	bool "drm_info"
	select BR2_PACKAGE_JSON_C
	help
	  Small utility to dump info about DRM devices
	
	  https://gitlab.freedesktop.org/emersion/drm_info
```

## package/librga/Config.in
```kconfig
config BR2_PACKAGE_LIBRGA
	bool "librga"
	help
	  Rockchip RGA (Raster Graphic Acceleration Unit)

	  https://gitee.com/nyanmisaka/rga
```

## package/msposd/Config.in
```kconfig
config BR2_PACKAGE_MSPOSD
	bool "msposd"
	help
	  OpenIPC implementation of MSP Displayport OSD for INAV/Betaflight/ArduPilot

	  https://github.com/OpenIPC/msposd
```

## package/pixelpilot/Config.in
```kconfig
config BR2_PACKAGE_PIXELPILOT
	bool "pixelpilot"
	select BR2_PACKAGE_ROCKCHIP_MPP
	help
	  Application that decodes an RTP Video Stream and displays it on screen, for Rockchip devices.

	  https://github.com/OpenIPC/PixelPilot_rk
```

## package/rkdeveloptool/Config.in.host
```kconfig
config BR2_PACKAGE_HOST_RKDEVELOPTOOL
        bool "host rkdeveloptool"
        help
          rkdeveloptool is a USB flashing software developed by Rockchip for Linux/macOS platforms.

          rkdeveloptool can be thought of as upgrade_tool for open source version.

          https://github.com/rockchip-linux/rkdeveloptool
```

## package/rockchip-mpp/Config.in
```kconfig
config BR2_PACKAGE_ROCKCHIP_MPP
	bool "rockchip-mpp"
	help
	  Rockchip Media Process Platform (MPP)

	  https://github.com/rockchip-linux/mpp
```

## package/rtl8812au/Config.in
```kconfig
config BR2_PACKAGE_RTL8812AU
	bool "rtl8812au"
	help
	  Patched rtl88xxau drivers for wfb-ng
	
	  https://github.com/svpcom/rtl8812au
```

## package/rtl88x2cu/Config.in
```kconfig
config BR2_PACKAGE_RTL88X2CU
	bool "rtl88x2cu"
	help
		Linux Driver for WiFi Adapters that are based on the RTL8812CU and RTL8822CU Chipsets with packet injection patch
```

## package/rtl88x2eu/Config.in
```kconfig
config BR2_PACKAGE_RTL88X2EU
	bool "rtl88x2eu"
	help
		Linux Driver for WiFi Adapters that are based on the RTL8812EU and RTL8822EU Chipsets with packet injection patch
```

## package/wfb-server/Config.in
```kconfig
config BR2_PACKAGE_WFB_SERVER
	bool "wfb-server"
	depends on BR2_PACKAGE_PYTHON3
	depends on BR2_PACKAGE_WIFIBROADCAST_NG
	select BR2_PACKAGE_PYTHON_SETUPTOOLS
	help
	  Control Plane for wfb-ng
	  Long-range packet radio link based on raw WiFi radio.
	  https://github.com/svpcom/wfb-ng
```

## package/wifibroadcast-ng/Config.in
```kconfig
config BR2_PACKAGE_WIFIBROADCAST_NG
	bool "wifibroadcast-ng"
	select BR2_PACKAGE_LIBPCAP
	select BR2_PACKAGE_LIBSODIUM
	select BR2_PACKAGE_LIBEVENT
	help
	  Long-range packet radio link based on raw WiFi radio.
	  https://github.com/svpcom/wfb-ng
```

## package/yaml-cli/Config.in
```kconfig
config BR2_PACKAGE_YAML_CLI
	bool "yaml-cli"
	help
	  Simple YAML console tool

	  https://github.com/OpenIPC/yaml-cli.git
```

## package/yq/Config.in
```kconfig
config BR2_PACKAGE_YQ
	bool "yq"
	help
	  yq is a portable command-line YAML, JSON, XML, CSV, TOML and properties processor

	  https://github.com/mikefarah/yq
```
