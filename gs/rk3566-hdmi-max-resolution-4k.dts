/dts-v1/;

/ {
    metadata {
        title = "Set maximum monitor resolution to 3840x2160";
        category = "misc";
        description = "Set maximum monitor resolution to 4K.";
	compatible = "radxa,rock-3a", "radxa,rock-3b", "radxa,rock-3c", "radxa,zero3", "radxa,e25";
    };

    fragment@0 {
        target-path = "/hdmi@fe0a0000";
        __overlay__ {
            preset_max_hdisplay = <3840>;
			preset_max_vdisplay = <2160>;
        };
    };
};

